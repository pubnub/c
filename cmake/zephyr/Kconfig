## cmake/zephyr/Kconfig
```kconfig
# Copyright (c) PubNub Inc.
# See LICENSE in the root directory of this source tree.

menu "PubNub C SDK"

config PUBNUB
    bool "PubNub C SDK"
    default y
    help
      Enable the PubNub C SDK. Disabling this removes all PubNub symbols
      from the build.

if PUBNUB

config PUBNUB_CFG_ARENA_POOL_SIZE
    int "Arena pool size (bytes)"
    default 40960
    help
      Size of the arena memory pool in bytes.

      When PUBNUB_ARENA_POOL_OWNER=user (default for embedded profile), this
      is the recommended size for the buffer you allocate and pass to
      pubnub_arena_allocator_init(). The SDK does not allocate any memory of
      this size itself.

      When PUBNUB_ARENA_POOL_OWNER=sdk (hosted profiles), this controls the
      size of the static BSS pool inside the SDK.

      The SDK build system computes a minimum required size from your feature
      set and concurrency limits. Check the CMake configure output for the
      '[PubNub] Arena:' line, or use PUBNUB_ARENA_RECOMMENDED_POOL_SIZE from
      allocator_arena.h. Reduce only if you see that value at configure time.

config PUBNUB_ENABLE_SECURE_TRANSPORT
    bool "Enable TLS secure transport"
    default y
    help
      Enables TLS for all PubNub connections (HTTPS/WSS).

      For CA certificate loading on NCS targets, also enable:
        CONFIG_MBEDTLS_BUILTIN_ROOT_CERTIFICATES=y
      This embeds the Mozilla root CA bundle in firmware flash and is
      selected automatically by the PubNub echo app prj.conf. Without it,
      TLS connections fail certificate verification at runtime and a
      compile-time notice is emitted.

      Requires: CONFIG_ENTROPY_HAS_DRIVER=y (for RNG seeding).

config PUBNUB_ZEPHYR_CA_CERT_PATH
    string "Filesystem path to PEM CA bundle (Zephyr only)"
    default ""
    depends on FILE_SYSTEM
    help
      When non-empty and CONFIG_FILE_SYSTEM=y, the SDK loads CA certificates
      from this path instead of the embedded bundle. This allows OTA-updating
      the CA bundle without reflashing firmware.

      Example: "/lfs/pubnub_ca.pem" for a LittleFS mount at /lfs.

      Leave empty to use the SDK's built-in bundle (Starfield Root CA G2,
      Starfield Services Root CA G2, Amazon Root CA 1, Amazon Root CA 3).
      The built-in bundle covers all current PubNub/AWS endpoint chains.

config PUBNUB_ENABLE_CUSTOM_DNS
    bool "Enable built-in UDP DNS resolver"
    default n
    help
      Use the SDK's built-in UDP DNS resolver instead of the Zephyr native
      resolver (dns_resolve_name). When enabled, the SDK sends its own DNS
      queries over a UDP socket, discovers system DNS servers via DHCP, and
      appends 8.8.8.8 / 1.1.1.1 as public fallbacks.

      When disabled (default), DNS resolution delegates to Zephyr's
      networking stack (dns_resolve_name), which is the recommended mode
      for most deployments.

      Enable when you need custom DNS servers via pubnub_set_dns_servers()
      or want to bypass the system resolver.

config PUBNUB_ENABLE_SUBSCRIBE
    bool "Enable Subscribe feature"
    default y
    help
      Enable real-time message subscription (long-poll).

config PUBNUB_ENABLE_PRESENCE
    bool "Enable Presence feature"
    default n
    depends on PUBNUB_ENABLE_SUBSCRIBE
    help
      Enable presence heartbeats and here-now queries.

config PUBNUB_ENABLE_PUBLISH
    bool "Enable Publish feature"
    default y
    help
      Enable message publishing.

config PUBNUB_ENABLE_SIGNAL
    bool "Enable Signal feature"
    default n
    help
      Enable lightweight signal publishing (< 64 bytes).

config PUBNUB_ENABLE_HISTORY
    bool "Enable History / Message Persistence feature"
    default n
    help
      Enable fetch_messages and message_counts endpoints.

config PUBNUB_ENABLE_MESSAGE_ACTIONS
    bool "Enable Message Actions feature"
    default n
    help
      Enable reactions and metadata on published messages.

config PUBNUB_ENABLE_CHANNEL_GROUPS
    bool "Enable Channel Groups feature"
    default n
    help
      Enable channel group management (add/remove/list channels).

config PUBNUB_ENABLE_OBJECTS
    bool "Enable App Context (Objects) feature"
    default n
    help
      Enable UUID and channel metadata management.

config PUBNUB_ENABLE_FILES
    bool "Enable File Share feature"
    default n
    help
      Enable file upload and download.

config PUBNUB_ENABLE_CRYPTO
    bool "Enable Crypto provider"
    default n
    help
      Enable AES-256-CBC payload encryption/decryption.
      Requires mbedTLS (CONFIG_MBEDTLS=y). On NCS this is typically
      also enabled by CONFIG_PUBNUB_ENABLE_SECURE_TRANSPORT=y.

endif # PUBNUB

endmenu
```

## examples/arena_echo_esp32/main/Kconfig.projbuild
```kconfig
menu "PubNub Arena Echo Example"

config PUBNUB_EXAMPLE_HAS_RGB_LED
    bool "Board has WS2812B RGB LED on GPIO 48"
    default y if IDF_TARGET_ESP32S3
    default n
    help
        Enable when the board has a WS2812B-compatible addressable RGB LED
        wired to GPIO 48.  The ESP32-S3-DevKitC-1 board has one; other
        boards may not.  When disabled all LED code is compiled out.

config PUBNUB_EXAMPLE_WIFI_SSID
    string "WiFi SSID"
    default "ssid"
    help
        SSID (network name) for the example to connect to.

config PUBNUB_EXAMPLE_WIFI_PASSWORD
    string "WiFi Password"
    default "pwd"
    help
        WiFi password (WPA or WPA2) for the example to connect to.

config PUBNUB_EXAMPLE_TASK_STACK_SIZE
    int "PubNub task stack size (bytes)"
    default 12288
    help
        Stack for the PubNub cooperative loop task. 12KB minimum
        recommended when TLS is enabled (mbedTLS handshake uses 5-6KB alone).

endmenu
```

## tests/iot_kitchensink/device/main/Kconfig.projbuild
```kconfig
menu "PubNub Kitchensink Configuration"

menu "WiFi"

config PUBNUB_KS_WIFI_SSID
    string "WiFi SSID"
    default ""
    help
        SSID (network name) for the device to connect to.
        Must be set before building.

config PUBNUB_KS_WIFI_PASSWORD
    string "WiFi Password"
    default ""
    help
        WiFi password (WPA2) for the device to connect to.
        Must be set before building.

endmenu

menu "PubNub Keys"

config PUBNUB_KS_SUB_KEY
    string "Subscribe Key"
    default ""
    help
        PubNub subscribe key. Must be set before building.

config PUBNUB_KS_PUB_KEY
    string "Publish Key"
    default ""
    help
        PubNub publish key. Must be set before building.

config PUBNUB_KS_CIPHER_KEY
    string "Cipher Key (optional)"
    default ""
    help
        AES cipher key for crypto module tests.
        Leave empty to skip crypto encryption tests.

config PUBNUB_KS_USER_ID
    string "User ID"
    default "esp32-ks-device"
    help
        PubNub user ID for this device.

endmenu

menu "Features"

config PUBNUB_KS_ENABLE_PRESENCE
    bool "Presence"
    default y
    help
        Enable presence tests (here_now, where_now, heartbeat).

config PUBNUB_KS_ENABLE_HISTORY
    bool "History (Message Persistence)"
    default y
    help
        Enable history / message persistence tests.

config PUBNUB_KS_ENABLE_MESSAGE_ACTIONS
    bool "Message Actions"
    default y
    help
        Enable message action add/get/remove tests.

config PUBNUB_KS_ENABLE_SIGNAL
    bool "Signal"
    default y
    help
        Enable signal send/receive tests.

config PUBNUB_KS_ENABLE_CHANNEL_GROUPS
    bool "Channel Groups"
    default y
    help
        Enable channel group management tests.

config PUBNUB_KS_ENABLE_APP_CONTEXT
    bool "App Context (Objects v2)"
    default y
    help
        Enable App Context (users, channels, memberships) tests.

config PUBNUB_KS_ENABLE_CRYPTO
    bool "Crypto"
    default y
    help
        Enable crypto module encrypt/decrypt tests.

config PUBNUB_KS_ENABLE_FILES
    bool "Files (S3 upload/download)"
    default y
    help
        Enable file upload/download tests (3-phase S3 operation).
        Disable for a lighter "core" build variant.

config PUBNUB_KS_ENABLE_COMPRESSION
    bool "Response Compression"
    default y
    help
        Enable compressed response handling tests.

config PUBNUB_KS_ENABLE_PAM
    bool "PAM / Access Manager"
    default n
    help
        PAM requires a secret key which must NEVER be in device
        firmware. This option exists only to produce a clear
        FATAL_ERROR if accidentally enabled. Do not enable.

endmenu

menu "Test Behavior"

config PUBNUB_KS_TASK_STACK_SIZE
    int "Task stack size (bytes)"
    default 16384
    range 8192 65536
    help
        Stack for the kitchensink FreeRTOS task. 16KB recommended
        when TLS + crypto are both enabled (mbedTLS handshake
        alone uses 5-6KB).

config PUBNUB_KS_TEST_TIMEOUT_MS
    int "Per-test timeout (ms)"
    default 15000
    help
        Maximum time each individual test may take before it is
        reported as a timeout failure.

config PUBNUB_KS_COMPANION_TIMEOUT_MS
    int "Companion handshake timeout (ms)"
    default 30000
    help
        How long to wait for the companion workstation to respond
        to the handshake message. Tests that require a companion
        are skipped when the handshake times out.

endmenu

endmenu
```
